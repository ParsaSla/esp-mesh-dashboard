## mesh-node/main/Kconfig.projbuild
```kconfig
menu "Mesh node settings"

config MESH_NODE_ROUTER_SSID
    string "Router SSID"
    default "parsaHome"
    help
        SSID of the 2.4 GHz router configured on the fixed mesh root.

config MESH_NODE_ROUTER_PASSWORD
    string "Router password"
    default "parsa@138405"
    help
        Router password configured on the fixed mesh root.

config MESH_NODE_AP_PASSWORD
    string "Mesh network password"
    default "mesh-password"
    help
        WPA2 mesh AP password. It must match the fixed root.

config MESH_NODE_MESH_ID
    string "Mesh ID (12 hexadecimal characters)"
    default "777777777777"
    help
        Six-byte mesh identifier. It must match the fixed root.

config MESH_NODE_MAX_LAYER
    int "Maximum mesh layer"
    range 1 25
    default 6
    help
        Maximum number of levels in the mesh topology.

config MESH_NODE_HEARTBEAT_INTERVAL_MS
    int "Heartbeat interval (milliseconds)"
    range 1000 3600000
    default 10000
    help
        Interval between application heartbeats sent to the mesh root.

endmenu
```

## mesh-root/main/Kconfig.projbuild
```kconfig
menu "Mesh root settings"

config MESH_ROOT_ROUTER_SSID
    string "Router SSID"
    default "parsaHome"
    help
        SSID of the 2.4 GHz Wi-Fi router used by the mesh root for its uplink.

config MESH_ROOT_ROUTER_PASSWORD
    string "Router password"
    default "parsa@138405"
    help
        Leave empty only when connecting to an open router network.

config MESH_ROOT_AP_PASSWORD
    string "Mesh network password"
    default "mesh-password"
    help
        WPA2 password used by mesh nodes when joining this network.
        Configure the same password in every node's firmware.

config MESH_ROOT_MESH_ID
    string "Mesh ID (12 hexadecimal characters)"
    default "777777777777"
    help
        Six-byte mesh identifier. Configure the same ID in every node's firmware.

config MESH_ROOT_MAX_LAYER
    int "Maximum mesh layer"
    range 1 25
    default 6
    help
        Maximum number of levels in the mesh topology.

endmenu
```
